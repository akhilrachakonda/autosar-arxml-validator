AUTOSAR XML
standard types defined: uint8
package /TypesPkg
  compu method Percent_Compu: 0..100; unit %
  unit Percent: display-name=%
  sender receiver interface BatteryIf
    data SoC: type=Percent_u8
    data SoC_BUG
  application sw component type BatteryMonitor
  application sw component type BatteryMonitor
